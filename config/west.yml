## config/west.yml
```yaml
manifest:
  remotes:
    - name: slicemk
      url-base: https://github.com/xudongzheng/
    - name: urob
      url-base: https://github.com/urob
    - name: ssbb
      url-base: https://github.com/ssbb
    - name: divisionst
      url-base: https://github.com/DivisionSt/
  projects:
    - name: zmk
      remote: slicemk
      # xudongzheng/zmk v20251223-rgb tip, SHA-pinned: he prunes old date-stamped
      # branches (v20250729-rgb vanished and broke the build); a SHA survives that.
      revision: 997e147744047475bcc9a00e28fc40c9d9a1e91e
      import: app/west.yml
    - name: zmk-helpers
      remote: urob
      revision: main
    - name: zmk-leader-key
      remote: divisionst
      path: modules/zmk/leader-key
      revision: max_bounds_check
    - name: zmk-tri-state
      remote: urob
      path: modules/zmk/tri-state
      revision: main
    - name: zmk-listeners
      remote: ssbb
      revision: v1
  self:
    path: config
```

## dts/bindings/behaviors/zmk,behavior-layer-id.yaml
```yaml
# Copyright (c) 2025 The ZMK Contributors
# SPDX-License-Identifier: MIT

description: Layer identification behavior that sends the current layer name as text

compatible: "zmk,behavior-layer-id"

include: zero_param.yaml

properties:
  layer-names:
    type: string-array
    required: true
    description: Array of layer names corresponding to layer indices
  
  prefix:
    type: string
    required: false
    default: "L: "
    description: Prefix string to send before the layer name
```
